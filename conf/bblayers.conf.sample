## conf/bblayers.conf.sample
```bitbake
# POKY_BBLAYERS_CONF_VERSION is increased each time build/conf/bblayers.conf
# changes incompatibly
POKY_BBLAYERS_CONF_VERSION = "2"

BBPATH = "${TOPDIR}"
BBFILES ?= ""

BBLAYERS ?= " \
  ##COREBASE##/../poky/meta \
  ##COREBASE##/../poky/meta-poky \
  ##COREBASE##/../meta-xilinx/meta-xilinx-core \
  ##COREBASE##/../meta-xilinx/meta-xilinx-standalone \
  ##COREBASE##/../meta-xilinx/meta-xilinx-contrib \
  ##COREBASE##/../meta-xilinx/meta-xilinx-bsp \
  ##COREBASE##/../meta-xilinx/meta-microblaze \
  ##COREBASE##/../meta-xilinx/meta-xilinx-vendor \
  ##COREBASE##/../meta-xilinx-tools \
  ##COREBASE##/../meta-adi/meta-adi-xilinx \
  ##COREBASE##/../meta-adi/meta-adi-core \
  ##COREBASE##/../meta-openembedded/meta-oe \
  ##COREBASE##/../meta-openembedded/meta-python \
  ##COREBASE##/../meta-openembedded/meta-networking \
  ##COREBASE##/../meta-openembedded/meta-filesystems \
  ##COREBASE##/../meta-qt5 \
  ##COREBASE##/../meta-sdr \
  ##COREBASE##/../meta-rwt-common \
  ##COREBASE##/../meta-rwt-oxygen \
  "
```

## conf/layer.conf
```bitbake
#We have a conf and classes directory, add to BBPATH
BBPATH .= ":${LAYERDIR}"

# We have recipes-* directories, add to BBFILES
BBFILES += "${LAYERDIR}/recipes-*/*/*.bb \
	${LAYERDIR}/recipes-*/*/*.bbappend"

BBFILE_COLLECTIONS += "meta-oxygen"
BBFILE_PATTERN_meta-oxygen = "^${LAYERDIR}/"
BBFILE_PRIORITY_meta-oxygen = "7"

LAYERSERIES_COMPAT_meta-oxygen = "warrior zeus"
```
