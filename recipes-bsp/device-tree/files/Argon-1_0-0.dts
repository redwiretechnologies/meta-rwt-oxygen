/dts-v1/;
/plugin/;


/ {
    fragment@0 {
        target = <&i2c1>;
        __overlay__ {
                  pca9534_0@20 {
                    compatible = "nxp,pcal6408";
                    reg = <0x20>;
                    gpio-controller;
                    #gpio-cells = <2>;
                    interrupt-parent = <&gpio>;
                    interrupts = <99 8>; /* IRQ_TYPE_LEVEL_LOW IRQ_TYPE_EDGE_FALLING */
                    gpio-line-names = "SYNTH_EN", "RX_MIX_EN", "TX_MIX_EN", "SPI_BRIDGE_INTn", "SPI_BRIDGE_RSTn", "PA_OVTMP", "SYTH_SDO", "PA_ALARM";
                  };
	              
                 
            };
        };

    
};
