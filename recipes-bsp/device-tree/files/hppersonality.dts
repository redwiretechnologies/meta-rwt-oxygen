/dts-v1/;
/plugin/;


/ {
    fragment@0 {
        target = <&i2c1>;
        __overlay__ {

            pca9534@25 {
                compatible = "nxp,pca9534";
                reg = <0x25>;
                gpio-controller;
                #gpio-cells = <2>;
                interrupt-parent = <&gpio>;
                interrupts = <99 8>; /* IRQ_TYPE_LEVEL_LOW IRQ_TYPE_EDGE_FALLING */
            };
        };
    };

    
};
