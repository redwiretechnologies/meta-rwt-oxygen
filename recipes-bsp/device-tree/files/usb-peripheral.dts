/dts-v1/;
/plugin/;


/ {
    fragment@0 {
        target = <&usb0>;
        __overlay__ {
            status = "okay";
        };
    };
    fragment@1 {
        target = <&dwc3_0>;
        __overlay__ {
            status = "okay";
            dr_mode = "peripheral";
        };
    };
};
